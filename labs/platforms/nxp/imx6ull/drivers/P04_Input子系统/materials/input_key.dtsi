#include <dt-bindings/gpio/gpio.h>
#include <dt-bindings/input/input.h>

/ {
    note_input_key: note-input-key {
        compatible = "linux-note,input-key-lab";
        pinctrl-names = "default";
        pinctrl-0 = <&pinctrl_note_input_key>;
        key-gpios = <&gpio1 18 GPIO_ACTIVE_LOW>;
        linux,code = <KEY_F13>;
        debounce-ms = <10>;
    };
};

&iomuxc {
    pinctrl_note_input_key: note-input-key-grp {
        fsl,pins = <
            /* 上拉与实际板级接线、供电条件一起确认。 */
            MX6UL_PAD_UART1_CTS_B__GPIO1_IO18 0x1b0b0
        >;
    };
};

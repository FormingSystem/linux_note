## labs/kernel/kernel_modules/materials/in_tree/hello_note/Kconfig
```kconfig
config HELLO_NOTE
    tristate "Hello note teaching example"
    help
      启用最小日志实验，用于学习配置与构建的连接。
      选择 M 生成可加载模块；选择 Y 将代码内建到内核。
      本实验不注册设备，不控制板上外设。
```

## labs/system_software/kconfig/materials/Kconfig
```kconfig
mainmenu "Kconfig 状态与构建输入实验"

config MODULES
    bool "允许模块状态"
    modules
    default y

config BUS
    tristate "示例总线支持"
    default m

menuconfig DRIVER
    tristate "示例驱动"
    depends on BUS
    select CHECKSUM
    imply TRACE
    help
      本实验只观察配置结果，不编译或加载真实驱动。
      驱动取值受到总线依赖限制。

if DRIVER

config BUFFER_SIZE
    int "缓冲区字节数"
    range 64 4096
    default 256

config DEVICE_LABEL
    string "设备标签"
    default "lesson"

config REGISTER_BASE
    hex "示例地址数值"
    range 0x1000 0xffff
    default 0x1000

choice
    prompt "完成通知方式"
    default MODE_POLL

config MODE_POLL
    bool "轮询"

config MODE_IRQ
    bool "中断"

endchoice

endif

config CHECKSUM
    bool

config TRACE
    bool "额外跟踪输出"

config SHOW_ADVANCED
    bool "显示高级菜单"

menu "高级菜单"
    visible if SHOW_ADVANCED

config ADVANCED_DEFAULT
    bool "菜单隐藏时仍可求值"
    default y

endmenu

source "extra/Kconfig"
```

## labs/system_software/kconfig/materials/extra/Kconfig
```kconfig
comment "默认值按声明顺序选择"

config DEFAULT_ORDER
    int
    default 10 if BUS
    default 20

config COPIED_DEFAULT
    int
    default DEFAULT_ORDER
```
